## firmware/sdkconfig.defaults
```kconfig
# Target
CONFIG_IDF_TARGET="esp32c3"

# Flash — ESP32-C3 modules ship with 4MB; our OTA layout needs it
CONFIG_ESPTOOLPY_FLASHSIZE_4MB=y
CONFIG_ESPTOOLPY_FLASHSIZE="4MB"

# CPU
CONFIG_ESP_DEFAULT_CPU_FREQ_MHZ_160=y

# Partition table
CONFIG_PARTITION_TABLE_CUSTOM=y
CONFIG_PARTITION_TABLE_CUSTOM_FILENAME="partitions.csv"
CONFIG_PARTITION_TABLE_OFFSET=0x8000

# FreeRTOS — Matter needs 1000 Hz tick
CONFIG_FREERTOS_HZ=1000

# Watchdog — commissioning can be slow
CONFIG_ESP_TASK_WDT_TIMEOUT_S=30
CONFIG_ESP_TASK_WDT_CHECK_IDLE_TASK_CPU0=n

# mbedTLS — Matter TLS requires larger record buffers
CONFIG_MBEDTLS_SSL_MAX_CONTENT_LEN=4096
CONFIG_MBEDTLS_ASYMMETRIC_CONTENT_LEN=y
CONFIG_MBEDTLS_SSL_IN_CONTENT_LEN=4096
CONFIG_MBEDTLS_SSL_OUT_CONTENT_LEN=4096
# HKDF required by Matter crypto (CHIPCryptoPALmbedTLS)
CONFIG_MBEDTLS_HKDF_C=y

# WiFi
CONFIG_ESP_WIFI_STATIC_RX_BUFFER_NUM=4
CONFIG_ESP_WIFI_DYNAMIC_RX_BUFFER_NUM=16
CONFIG_ESP_WIFI_TX_BUFFER_TYPE_DYNAMIC=y

# Disable unused commissioning methods to save flash
CONFIG_ENABLE_CHIP_SHELL=n
CONFIG_CHIP_ENABLE_WIFI_TELEMETRY=n

# OTA — enable for future hub-triggered OTA
CONFIG_ENABLE_OTA_REQUESTOR=y

# Log level (set to WARN in production)
CONFIG_LOG_DEFAULT_LEVEL_WARN=y
CONFIG_LOG_MAXIMUM_LEVEL_DEBUG=y
```
